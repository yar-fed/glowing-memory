/dts-v1/;
    /plugin/;
    / {
           compatible = "brcm,bcm2835", "brcm,bcm2708", "brcm,bcm2709";

           fragment@0 {
              target-path = "/";
              __overlay__ {
                 keypad: MATRIX4x4 {
                    compatible = "gpio-matrix-keypad";
                    debounce-delay-ms = <30>;
                    col-scan-delay-us = <30>;
                    /* 
		       try to use GPIO only lines
                       to keep SPI and I2C usable
                    */
                    row-gpios = <&gpio 23 0    // 1
                                 &gpio 13 0    // 2
                                 &gpio 19 0    // 3
                                 &gpio 26 0>;  // 4

                    col-gpios = <&gpio 12 0    // 5
                                 &gpio 16 0    // 6
                                 &gpio 20 0    // 7
                                 &gpio 21 0>;  // 8

					linux,no-autorepeat = <1>;
					linux,no-multy = <1>;
                    /*
                      Keycodes from /usr/include/linux/input-event-codes.h
                      converted to hex using printf '%02x\n'
                    */

                    linux,keymap = <
                                    0x0000004f		// col0 row0
                                    0x0100004b		// col0 row1
                                    0x02000047		// col0 row2
                                    0x03000069		// col0 row3
                                    0x00010050		// col1 row0
                                    0x0101004c		// col1 row1
                                    0x02010048		// col1 row2
                                    0x03010052		// col1 row3
                                    0x00020051		// col2 row0
                                    0x0102004d		// col2 row1
                                    0x02020049		// col2 row2
                                    0x0302006c		// col2 row3
                                    0x00030001		// col3 row0
                                    0x01030067		// col3 row1
                                    0x0203006a		// col3 row2
                                    0x03030060>;	// col3 row3
                 };
              };
           };
      };
